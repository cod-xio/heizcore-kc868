## sdkconfig.defaults
```kconfig
# Ziel
CONFIG_IDF_TARGET="esp32"

# Flash / Partitionen (KC868-A6/A8: 4 MB)
CONFIG_ESPTOOLPY_FLASHSIZE_4MB=y
CONFIG_PARTITION_TABLE_CUSTOM=y
CONFIG_PARTITION_TABLE_CUSTOM_FILENAME="partitions.csv"

# FreeRTOS
CONFIG_FREERTOS_HZ=1000

# Netzwerk
CONFIG_LWIP_MAX_SOCKETS=16
CONFIG_ESP_WIFI_SOFTAP_SUPPORT=y

# Ethernet (KC868-A8: LAN8720 RMII)
CONFIG_ETH_ENABLED=y
CONFIG_ETH_USE_ESP32_EMAC=y
CONFIG_ETH_PHY_INTERFACE_RMII=y
CONFIG_ETH_RMII_CLK_INPUT=y
CONFIG_ETH_RMII_CLK_IN_GPIO=0

# HTTP-Server
CONFIG_HTTPD_MAX_REQ_HDR_LEN=1024
CONFIG_HTTPD_MAX_URI_LEN=512
CONFIG_HTTPD_WS_SUPPORT=y

# mbedTLS / HTTPS-OTA
CONFIG_ESP_HTTPS_OTA_ALLOW_HTTP=y
CONFIG_MBEDTLS_CERTIFICATE_BUNDLE=y

# NVS + Watchdog
CONFIG_ESP_TASK_WDT_TIMEOUT_S=15

# Logging
CONFIG_LOG_DEFAULT_LEVEL_INFO=y

# App-Rollback für OTA
CONFIG_BOOTLOADER_APP_ROLLBACK_ENABLE=y
```
